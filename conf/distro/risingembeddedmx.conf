## conf/distro/risingembeddedmx.conf
```bitbake
MAINTAINER = "octavioraziel.gdn@gmail.com"
require conf/distro/poky.conf

DISTRO = "risingembeddedmx"
DISTRO_NAME = "risingembeddedmx"
DISTRO_VERSION = "1.0"
DISTRO_CODENAME = "olin"
DISTRO_FEATURES:remove = " sysvinit bluetooth pcmcia wayland bluez5 pci ext2 irda x11 nfc ptest 3g"
#DISTRO_FEATURES:remove += " sysvinit  ptest 3g"
DISTRO_FEATURES:append = " systemd wifi opengl pam pulseaudio egl alsa-plugins"

DISTRO_FEATURES_BACKFILL_CONSIDERED += " sysvinit"
VIRTUAL-RUNTIME_init_manager = "systemd"
VIRTUAL-RUNTIME_initscripts = "systemd-compat-units"
hostname_pn-base-files = "risingembeddedmx"
# Set locale
GLIBC_GENERATE_LOCALES = "en_US.UTF-8"
IMAGE_LINGUAS = "en-us"

# Set default timezone
DEFAULT_TIMEZONE = "America/Monterrey" 
```
